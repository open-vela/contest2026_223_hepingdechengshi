## board/contest_board/configs/nsh/defconfig
```kconfig
# Minimal placeholder defconfig for contest2026_000_board.
# Not intended to boot real hardware; sample only.
CONFIG_ARCH="arm"
CONFIG_ARCH_BOARD_CUSTOM=y
CONFIG_ARCH_BOARD_CONTEST2026_000_BOARD=y
CONFIG_ARCH_BOARD_CUSTOM_NAME="nsh"
CONFIG_ARCH_BOARD_CUSTOM_DIR="../vendor/beken/boards/contest2026_223_board/"
CONFIG_ARM_THUMB=y
CONFIG_ARCH_CHIP_ARM_CUSTOM=y
CONFIG_ARCH_CHIP_CUSTOM=y
CONFIG_ARCH_CHIP_CUSTOM_DIR="../vendor/beken/chips/bk7258"
CONFIG_INIT_ENTRYPOINT="nsh_main"
CONFIG_NSH_BUILTIN_APPS=y
CONFIG_NSH_FILEIOSIZE=512
CONFIG_NSH_LINELEN=64
CONFIG_NSH_READLINE=y
CONFIG_SYSTEM_NSH=y
```

## boards/bk7258_ap/Kconfig
```kconfig
#
# Contest 2026 team 000 board placeholder
#
if ARCH_BOARD_CUSTOM
comment "Beken Board Configuration Options"

config ARCH_BOARD_CONTEST2026_000_BOARD
	bool "Contest Board"
	default y

if ARCH_BOARD_CONTEST2026_000_BOARD

comment "Beken Contest Board"

config ARCH_BOARD_CONTEST2026_000_BOARD_TAG
	string "Board tag"
	default "contest2026_000_board"

endif

config BEKEN_AVDK_SMP_SOURCE
	string "Source of bk_avdk_smp"
	default "/home/crane/codebase/armino/bk_avdk_smp“


endif
```

## boards/bk7258_ap/configs/nsh/defconfig
```kconfig
# Minimal placeholder defconfig for contest2026_000_board.
# Not intended to boot real hardware; sample only.
CONFIG_ARCH="arm"
CONFIG_ARCH_BOARD_CUSTOM=y
CONFIG_ARCH_BOARD_CONTEST2026_000_BOARD=y
CONFIG_ARCH_BOARD_CUSTOM_NAME="nsh"
CONFIG_ARCH_BOARD_CUSTOM_DIR="../vendor/beken/boards/bk7258_ap/"
CONFIG_ARM_THUMB=y
CONFIG_ARCH_CHIP_ARM_CUSTOM=y
CONFIG_ARCH_CHIP_CUSTOM=y
CONFIG_ARCH_CHIP_CUSTOM_DIR="../vendor/beken/chips/bk7258"
CONFIG_ARCH_CHIP_BK7258=y
CONFIG_ARCH_SETJMP_H=y
CONFIG_INIT_ENTRYPOINT="nsh_main"
CONFIG_NSH_BUILTIN_APPS=y
CONFIG_NSH_FILEIOSIZE=512
CONFIG_NSH_LINELEN=64
CONFIG_NSH_READLINE=y
CONFIG_SCHED_WAITPID=y
CONFIG_SYSTEM_NSH=y
CONFIG_SMP=y
CONFIG_SMP_NCPUS=2
CONFIG_CPU_CNT=2
CONFIG_SOC_SMP=y
CONFIG_SOC_BK7258=y
CONFIG_SOC_ARCH="cm33"
CONFIG_MPU=y
CONFIG_SPE=1
CONFIG_SPINLOCK_SECTION=y
CONFIG_PSRAM=y
CONFIG_PSRAM_AS_SYS_MEMORY=y
CONFIG_ARCH_INTERRUPTSTACK=2048
CONFIG_BK_CMSIS=y
CONFIG_AON_PMU=y
CONFIG_SYSTEM_CTRL=y
CONFIG_MAILBOX=y
CONFIG_PWM_V1PX=y
CONFIG_WIFI_VNET_CONTROLLER=y
CONFIG_MSDU_RESV_HEAD_LENGTH=108
CONFIG_INT_WDT=y
CONFIG_INT_WDT_PERIOD_MS=8000
CONFIG_TASK_WDT=y
CONFIG_TASK_WDT_PERIOD_MS=16000
CONFIG_MAILBOX_V2_0=y
CONFIG_DEBUG_SYMBOLS=y
CONFIG_PRIORITY_INHERITANCE=y
CONFIG_BK_PRINTF_DISABLE=y
CONFIG_DEBUG_ASSERTIONS=y
CONFIG_EFUSE=n
CONFIG_DEBUG_AP_STARTUP=y
CONFIG_BOARD_LATE_INITIALIZE=y
CONFIG_SPINLOCK_DEBUG=n
CONFIG_INTELHEX_BINARY=y
CONFIG_RAW_BINARY=y
CONFIG_DEBUG_SCHED=y
CONFIG_DEBUG_SCHED_ERROR=y
CONFIG_DEBUG_SCHED_INFO=y
CONFIG_DEBUG_SCHED_WARN=y
CONFIG_DEBUG_INFO=y
CONFIG_DEBUG_WARN=y
CONFIG_DEBUG_FEATURES=y
CONFIG_SYSLOG_DEFAULT=y
CONFIG_ARCH_LOWPUTC=y
CONFIG_GRAPHICS_LVGL=y
CONFIG_LIB_FREETYPE=y
CONFIG_EXAMPLES_LVGLDEMO=y
CONFIG_LVX_USE_DEMO_CONTEST2026_000_HELLO_APP=y
CONFIG_LIBUV=y
CONFIG_TLS_NELEM=4
CONFIG_TLS_TASK_NELEM=4
# LVGL config
CONFIG_LV_USE_CLIB_MALLOC=y
CONFIG_LV_USE_CLIB_SPRINTF=y
CONFIG_LV_USE_CLIB_STRING=y
CONFIG_LV_USE_DEMO_WIDGETS=y
CONFIG_LV_USE_LOG=y
CONFIG_LV_USE_NUTTX=y
CONFIG_LV_USE_NUTTX_TOUCHSCREEN=y
CONFIG_NSH_BUILTIN_APPS=y
CONFIG_BUILTIN=y
CONFIG_NSH_ALIAS=y
CONFIG_NSH_ALTCONDEV=y
CONFIG_NSH_ARCHINIT=y
CONFIG_NSH_ARGCAT=y
CONFIG_NSH_BUILTIN_APPS=y
CONFIG_NSH_CMDOPT_DD_STATS=y
CONFIG_NSH_CMDOPT_HEXDUMP=y
CONFIG_NSH_CMDPARMS=y
CONFIG_NSH_MAXARGUMENTS=16
CONFIG_NSH_NESTDEPTH=6
CONFIG_NSH_QUOTE=y
CONFIG_PIPES=y
CONFIG_LCD=y
CONFIG_LCD_ST7701SN=y
CONFIG_LCD_FRAMEBUFFER=y
CONFIG_FS_PROCFS=y
CONFIG_FS_PROCFS_REGISTER=y
CONFIG_FLASH_MB=y
CONFIG_SARADC_MB=y
CONFIG_SYSLOG_MAX_CHANNELS=2
CONFIG_SYSLOG_BUFFER=y
CONFIG_SYSLOG_INTBUFFER=y  
CONFIG_SYSLOG_INTBUFSIZE=1024
```

## chip/bk7258/Kconfig
```kconfig
#
# For a description of the syntax of this configuration file,
# see the file kconfig-language.txt in the NuttX tools repository.
#

if ARCH_CHIP_CUSTOM

comment "Beken Configuration Options"

choice
    prompt "Beken Chip Selection"
    default ARCH_CHIP_BK7258

config SOC_BK7236XX
    bool "soc_bk7236xx"

config ARCH_CHIP_BK7258
	bool "bk7258"
 	select ARCH_ARMV8M
	select ARCH_CORTEXM33
    select ARCH_HAVE_FPU
	select ARCH_HAVE_MPU
	# select ARCH_HAVE_FETCHADD
	# select ARCH_HAVE_HEAPCHECK
	# select ARCH_HAVE_PROGMEM
	# select ARCH_HAVE_SPI_BITORDER
	# select ARM_HAVE_MPU_UNIFIED
	# select ARMV8M_HAVE_STACKCHECK
	# select ARMV8M_USEBASEPRI
	# select ARMV8M_HAVE_ICACHE
	# select ARMV8M_HAVE_DCACHE
	# select ARMV8M_ICACHE
	# select ARMV8M_DCACHE
	# select ARCH_ICACHE
	# select ARCH_DCACHE
	# select BF0_HCPU

endchoice

menu "bk7258"

	config ITCM_SIZE
		hex "Total ITCM size"
		default 0x4000

	config DTCM_SIZE
		hex "Total DTCM size"
		default 0x4000

	config ANA_REG_WRITE_POLL_REG_B
		bool "Write analog register polls sys reg0xb"
		default y

	config PM_HAL_DEBUG
		bool "Enable PM hal debug"
		default n

	config PM_HAL_CTRL
		bool "Enable PM hal debug"
		default n

        config TZ
                bool "Supported TrustZone"
                default y

        config SPE
                int "Enable SPE"
                default 0

	config RX_OPTIMIZE
		bool "Optimize rx current"
		default n

	config BT_REUSE_MEDIA_MEMORY
		bool "BT reuse media memory at beging of cpu1"
		default n

endmenu

endif
```

## chips/Kconfig
```kconfig
# Beken custom-chip dispatcher.

if ARCH_CHIP_CUSTOM
source "../vendor/beken/chips/bk7258/Kconfig"
endif
```

## chips/component/Kconfig
```kconfig
source "../vendor/beken/chips/component/bk_wifi_driver/Kconfig"
source "../vendor/beken/chips/component/bk_wifi/Kconfig"
source "../vendor/beken/chips/component/lwip_intf_v2_1/Kconfig"
source "../vendor/beken/chips/component/easy_log/Kconfig"
source "../vendor/beken/chips/component/bk_pm/Kconfig"
source "../vendor/beken/chips/component/bk_system/Kconfig"
```

## chips/component/bk_peripheral/Kconfig
```kconfig
menu "bk peripheral"
	source "../vendor/beken/chips/component/bk_peripheral/src/lcd/rgb/Kconfig"
	source "../vendor/beken/chips/component/bk_peripheral/src/lcd/mcu/Kconfig"
	source "../vendor/beken/chips/component/bk_peripheral/src/lcd/qspi/Kconfig"
	source "../vendor/beken/chips/component/bk_peripheral/src/lcd/spi/Kconfig"
	source "../vendor/beken/chips/component/bk_peripheral/src/dvp/Kconfig"
	source "../vendor/beken/chips/component/bk_peripheral/src/tp/Kconfig" 
endmenu
```

## chips/component/easy_log/Kconfig
```kconfig
menu "Easy Log"

    config EASY_LOG
        bool "Enable Easy Log"
        default y
        help
            Enable easy log output via mailbox UART.

    config EASY_LOG_UART_ID
        depends on EASY_LOG
        int "Mailbox UART ID for Easy Log"
        range 0 2
        default 0
        help
            Select the mailbox UART device ID to use for easy log output.
            0: MB_UART0, 1: MB_UART1, 2: MB_UART2.
endmenu
```

## chips/drivers/Kconfig
```kconfig
menu "Driver"
	source "../vendor/beken/chips/drivers/device/Kconfig"
	source "../vendor/beken/chips/drivers/wdt/Kconfig"
	source "../vendor/beken/chips/drivers/aon_wdt/Kconfig"
	source "../vendor/beken/chips/drivers/uart/Kconfig"
	source "../vendor/beken/chips/drivers/trng/Kconfig"
	source "../vendor/beken/chips/drivers/sdio_host/Kconfig"
	source "../vendor/beken/chips/drivers/sd_card/Kconfig"
	source "../vendor/beken/chips/drivers/sdio/Kconfig"
	source "../vendor/beken/chips/drivers/spi/Kconfig"
	source "../vendor/beken/chips/drivers/qspi/Kconfig"
	source "../vendor/beken/chips/drivers/rtc/Kconfig"
	source "../vendor/beken/chips/drivers/gpio/Kconfig"
	source "../vendor/beken/chips/drivers/pmu/Kconfig"
	source "../vendor/beken/chips/drivers/general_dma/Kconfig"
	source "../vendor/beken/chips/drivers/touch/Kconfig"
	source "../vendor/beken/chips/drivers/sbc/Kconfig"
	source "../vendor/beken/chips/drivers/jpeg_enc/Kconfig"
	source "../vendor/beken/chips/drivers/jpeg_dec/Kconfig"
	source "../vendor/beken/chips/drivers/psram/Kconfig"
	source "../vendor/beken/chips/drivers/calendar/Kconfig"
	source "../vendor/beken/chips/drivers/sys_ctrl/Kconfig"
	source "../vendor/beken/chips/drivers/phy/Kconfig"
	source "../vendor/beken/chips/drivers/i2s/Kconfig"
	source "../vendor/beken/chips/drivers/i2c/Kconfig"
	source "../vendor/beken/chips/drivers/audio/Kconfig"
	source "../vendor/beken/chips/drivers/pwm/Kconfig"
	source "../vendor/beken/chips/drivers/icu/Kconfig"
	source "../vendor/beken/chips/drivers/timer/Kconfig"
	source "../vendor/beken/chips/drivers/saradc/Kconfig"
	source "../vendor/beken/chips/drivers/flash/Kconfig"
	source "../vendor/beken/chips/drivers/h264/Kconfig"
	source "../vendor/beken/chips/drivers/sdmadc/Kconfig"
	source "../vendor/beken/chips/drivers/pwr_clk/Kconfig"
	source "../vendor/beken/chips/drivers/otp/Kconfig"
	source "../vendor/beken/chips/drivers/fft/Kconfig"
	source "../vendor/beken/chips/drivers/hw_rotate/Kconfig"
	source "../vendor/beken/chips/drivers/yuv_buf/Kconfig"
	source "../vendor/beken/chips/drivers/lcd/Kconfig"
	source "../vendor/beken/chips/drivers/irda/Kconfig"
	source "../vendor/beken/chips/drivers/reset_reason/Kconfig"
	source "../vendor/beken/chips/drivers/efuse/Kconfig"
	source "../vendor/beken/chips/drivers/mailbox/Kconfig"
	source "../vendor/beken/chips/drivers/tp/Kconfig"
	source "../vendor/beken/chips/drivers/dma2d/Kconfig"
	source "../vendor/beken/chips/drivers/chip_support/Kconfig"
	source "../vendor/beken/chips/drivers/eth/Kconfig"
	source "../vendor/beken/chips/drivers/ckmn/Kconfig"
	source "../vendor/beken/chips/drivers/hw_scale/Kconfig"
	source "../vendor/beken/chips/drivers/lin/Kconfig"
	source "../vendor/beken/chips/drivers/scr/Kconfig"
	source "../vendor/beken/chips/drivers/jpeg_dec/Kconfig"
	source "../vendor/beken/chips/drivers/spinlock/Kconfig"
	source "../vendor/beken/chips/drivers/slcd/Kconfig"
	source "../vendor/beken/chips/drivers/can/Kconfig"
endmenu
```
